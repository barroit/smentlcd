## scripts/Kconfig.runtime
```kconfig
# SPDX-License-Identifier: GPL-3.0-or-later

menu "Runtime defaults"

config UTF8_LOCALE
	string "Default LC_CTYPE"
	default "$(utf8-locale)"

config SMENT_VID
	int "SpaceMouse Enterprice vendor ID"
	default 0x$(cut,$(first-line,device_info),1)

config SMENT_PID
	int "SpaceMouse Enterprice product ID"
	default 0x$(cut,$(first-line,device_info),2)

config RECORD_SHOW_TIMESTAMP
	bool "Prefix record message with timestamp"
	default n

config LOG_MESSAGE_RING_SIZE
	int "Message queue size of logging system"
	default 512

config LOG_MESSAGE_BUFFER_SIZE
	int "Message buffer size of logging system"
	default 2048

config IPC_SOCKET_NAME
	string "IPC socket name"
	default "smentlcd.sock"

config IPC_REQ_TIMEOUT
	int "IPC request timeout"
	default 39393939

config IMAGE_WIDTH_MAX
	int "Maximum width of image"
	default 640

config IMAGE_HEIGHT_MAX
	int "Maximum height of image"
	default 150

choice
	prompt "Image compression level"
	default IMAGE_COMPRESS_MEDIUM

config IMAGE_COMPRESS_LOW
	bool "Low"

config IMAGE_COMPRESS_MEDIUM
	bool "Medium"

config IMAGE_COMPRESS_HIGH
	bool "High"

config IMAGE_COMPRESS_MAX
	bool "Maximum"

endchoice

config IMAGE_COMPRESS_LEVEL
	int
	default 1 if IMAGE_COMPRESS_LOW
	default 6 if IMAGE_COMPRESS_MEDIUM
	default 9 if IMAGE_COMPRESS_HIGH
	default 12 if IMAGE_COMPRESS_MAX

config PACKET_HEADER_SIZE
	int "Size of packet header"
	default 512

config PACKET_FRAME_SIZE
	int "Size of each frame for packet"
	default 65535

endmenu # Runtime defaults
```
