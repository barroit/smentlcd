## Kconfig
```kconfig
# SPDX-License-Identifier: GPL-3.0-or-later

mainmenu "$(repo-name)/$(host-arch)-$(host-name) $(repo-version) Configuration"

$(warn-off)

source "kconfig/compile"

source "kconfig/runtime"
```
